## buildroot/package/libinih/Config.in
```kconfig
config BR2_PACKAGE_LIBINIH
	bool "libinih"
	default n
	help
	 Simple .INI file parser in C, good for embedded systems
	 https://github.com/benhoyt/inih
```

## buildroot/package/libnl3/Config.in
```kconfig
config BR2_PACKAGE_LIBNL3
	bool "libnl3"
	default n
	help
	 Netlink protocol library suite
	 https://www.infradead.org/~tgr/libnl/
```

## buildroot/package/libubox/Config.in
```kconfig
config BR2_PACKAGE_LIBUBOX
	bool "libubox"
	default n
	help
	  libubox is required by many of openwrt utilities like uci, ubus

	  https://openwrt.org/docs/techref/libubox
```

## buildroot/package/map_api_test/Config.in
```kconfig
config BR2_PACKAGE_MAP_API_TEST
        bool "map_api_test"
        default n
        help
          Tool used for MAP api testing.
```

## buildroot/package/pktlogger_d/Config.in
```kconfig
config BR2_PACKAGE_PKTLOGGER_D
	bool "pktlogger_d"
	default y
	select BR2_PACKAGE_Q_UTILS
	help
	  Packetlogger daemon functionality.
```

## buildroot/package/qdock/Config.in
```kconfig
config BR2_PACKAGE_QDOCK
	bool "QDOCK"
	default n
	help
	  Quantenna QDocK framework.
```

## buildroot/package/qharvest/Config.in
```kconfig
config BR2_PACKAGE_QHARVEST
	bool "Qharvest"
	default n
	select BR2_PACKAGE_JSON_C
	select BR2_PACKAGE_LIBCURL
	select BR2_PACKAGE_OPENSSL
	select BR2_PACKAGE_ZLIB
	help
	  Quantenna Harvest.

config BR2_PACKAGE_QHARVEST_QWE
	bool "Qharvest with QWE HAL support"
	default y
	depends BR2_PACKAGE_QHARVEST
	depends BR2_PACKAGE_QWE_PAL
```

## buildroot/package/qrpe/Config.in
```kconfig
config BR2_PACKAGE_QRPE
	bool "QRPE"
	default n
        help
	  Quantenna Radio Peer Entry
```

## buildroot/package/qserver/Config.in
```kconfig
config BR2_PACKAGE_QSERVER
	bool "Quantenna private connections management server"
	default y
	help
	  A server to manage Quantenna private connections
```

## buildroot/package/qtm/Config.in
```kconfig
config BR2_PACKAGE_QTM
	bool "Quantenna Traffic Management"
	default n
	help
	  Quantenna Traffic Management
```

## buildroot/package/qtn_security/Config.in
```kconfig
config BR2_PACKAGE_QTN_SECURITY
	bool "qtn_security"
	default y
	help
	  Quantenna Security Configuration Library
```

## buildroot/package/qweadapter/Config.in
```kconfig
config BR2_PACKAGE_QWE_ADAPTER
        bool "QWE Adapter"
        default n
        help
          Quantenna Wireless Extension Adapter

config BR2_PACKAGE_QWE_ADAPTER_RPE
	bool "RPE for QWE Adapter"
	default n
	help
	  RPE for Quantenna Wireless Extension Adapter
```

## buildroot/package/qwebapi/Config.in
```kconfig
config BR2_PACKAGE_QWEBAPI
        bool "QWEBAPI"
        default n
        help
          Quantenna WEB API
```

## buildroot/package/qwebphpif5524/Config.in
```kconfig
config BR2_PACKAGE_QWEBPHPIF5524
	bool "qwebphpif5524"
	default n
	help
           Quantenna PHP Web interface for QV864.
```

## buildroot/package/traceroute/Config.in
```kconfig
config BR2_PACKAGE_TRACEROUTE
	bool "traceroute"
	default n
	help
		Traceroute tracks the route packets taken from an IP network
		on their way to given host.
```

## buildroot/package/ubus/Config.in
```kconfig
config BR2_PACKAGE_UBUS
	bool "ubus"
	default n
	help
	  ubus provides communication between various daemons and applications

	  https://openwrt.org/docs/techref/ubus
```

## buildroot/package/zhostapd/Config.in
```kconfig
config BR2_PACKAGE_ZHOSTAPD
	bool "zhostapd"
	default y
	select BR2_PACKAGE_QTN_SECURITY
	help
	  EAP, RADIUS client, etc.

	  Sourced from the Prism driver.
```
